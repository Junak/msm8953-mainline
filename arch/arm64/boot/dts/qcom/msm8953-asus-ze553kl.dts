// SPDX-License-Identifier: BSD-3-Clause
/*
 * Copyright (c) 2024, Antony Kurniawan S. <postmarketos@smankusors.com>
 */
/dts-v1/;

#include "msm8953-asus-common.dtsi"

/ {
	compatible = "asus,zenfone3", "asus,ze553kl", "qcom,msm8953";
	model = "Asus Zenfone 3 (ZE553KL)";
};

&battery {
	charge-full-design-microamp-hours = <4900000>;
};

&sound_card {
	model = "asus-ze553kl";
};

&zap_shader {
	firmware-name = "qcom/msm8953/asus/ze553kl/a506_zap.mdt";
};
