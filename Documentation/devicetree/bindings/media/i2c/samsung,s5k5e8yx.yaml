## Documentation/devicetree/bindings/media/i2c/samsung,s5k5e8yx.yaml
```yaml
# SPDX-License-Identifier: (GPL-2.0-only OR BSD-2-Clause)
%YAML 1.2
---
$id: http://devicetree.org/schemas/media/i2c/samsung,s5k5e8yx.yaml#
$schema: http://devicetree.org/meta-schemas/core.yaml#

title: Samsung S5K5E8YX Image Sensor

description:
  Samsung S5K5E8YX image sensor is a 5MP CMOS image sensor.
  The sensor is controlled over a serial camera control bus protocol,
  the widest supported output image frame size is 2608x1960 at 30 frames
  per second, data output format is RAW10 transferred over 2-lane
  MIPI D-PHY interface.

maintainers:
  - Andrii Cherniavskyi <chernyav.a@gmail.com>

allOf:
  - $ref: /schemas/media/video-interface-devices.yaml#

properties:
  compatible:
    const: samsung,s5k5e8yx

  reg:
    maxItems: 1

  clocks:
    description: MCLK supply clock.
    maxItems: 1

  reset-gpios:
    description: Active low GPIO connected to RESET pad of the sensor.
    maxItems: 1

  vdda-supply:
    description: Analogue voltage supply, 2.8 volts.

  vddd-supply:
    description: Digital core voltage supply, 1.2 volts.

  vddio-supply:
    description: Digital I/O voltage supply, 1.8 or 2.8 volts.

  port:
    $ref: /schemas/graph.yaml#/$defs/port-base
    additionalProperties: false

    properties:
      endpoint:
        $ref: /schemas/media/video-interfaces.yaml#
        unevaluatedProperties: false

        properties:
          link-frequencies: true
          remote-endpoint: true

        required:
          - link-frequencies
          - remote-endpoint

required:
  - compatible
  - reg
  - clocks
  - port

unevaluatedProperties: false

examples:
  - |
      #include <dt-bindings/gpio/gpio.h>

      i2c {
          #address-cells = <1>;
          #size-cells = <0>;

          camera@2d {
              compatible = "samsung,s5k5e8yx";
              reg = <0x2d>;
              clocks = <&camera_mclk 0>;
              assigned-clocks = <&camera_mclk 0>;
              assigned-clock-rates = <24000000>;
              reset-gpios = <&gpio1 10 GPIO_ACTIVE_LOW>;
              vdda-supply = <&vreg_2p8>;
              vddd-supply = <&vreg_1p2>;
              vddio-supply = <&vreg_1p8>;

              port {
                  endpoint {
                      link-frequencies = /bits/ 64 <500000000>;
                      remote-endpoint = <&mipi_csi2_ep>;
                  };
              };
          };
      };
...
```

## Documentation/devicetree/bindings/power/supply/qcom,pmi632-charger.yaml
```yaml
# SPDX-License-Identifier: (GPL-2.0-only OR BSD-2-Clause)
%YAML 1.2
---
$id: http://devicetree.org/schemas/power/supply/qcom,pmi632-charger.yaml#
$schema: http://devicetree.org/meta-schemas/core.yaml#

title: Qualcomm PMI632 Switch-Mode Battery Charger

maintainers:
  - Marc Lainez <marc.lainez@gmail.com>

description:
  The SMB5 charger block in the Qualcomm PMI632 PMIC provides USB charging
  with automatic power source detection (APSD), input current limiting
  (AICL), and hardware-based JEITA temperature compliance. It supports
  SDP, CDP, DCP, and float charger types.

properties:
  compatible:
    const: qcom,pmi632-charger

  reg:
    maxItems: 1

  interrupts:
    minItems: 4
    maxItems: 4

  interrupt-names:
    items:
      - const: usb-plugin
      - const: bat-ov
      - const: wdog-bark
      - const: usbin-icl-change

  io-channels:
    items:
      - description: USB input current in uA
      - description: USB input voltage in uV

  io-channel-names:
    items:
      - const: usbin_i
      - const: usbin_v

  monitored-battery:
    description: phandle to the simple-battery node
    $ref: /schemas/types.yaml#/definitions/phandle

required:
  - compatible
  - reg
  - interrupts
  - interrupt-names
  - io-channels
  - io-channel-names
  - monitored-battery

additionalProperties: false

examples:
  - |
    #include <dt-bindings/interrupt-controller/irq.h>

    pmic {
      #address-cells = <1>;
      #size-cells = <0>;
      #interrupt-cells = <4>;

      charger@1000 {
        compatible = "qcom,pmi632-charger";
        reg = <0x1000>;

        interrupts = <0x2 0x13 0x4 IRQ_TYPE_EDGE_BOTH>,
                     <0x2 0x12 0x2 IRQ_TYPE_EDGE_BOTH>,
                     <0x2 0x16 0x1 IRQ_TYPE_EDGE_RISING>,
                     <0x2 0x13 0x7 IRQ_TYPE_EDGE_RISING>;
        interrupt-names = "usb-plugin",
                          "bat-ov",
                          "wdog-bark",
                          "usbin-icl-change";

        io-channels = <&pmi632_adc 0x07>,
                      <&pmi632_adc 0x08>;
        io-channel-names = "usbin_i",
                           "usbin_v";

        monitored-battery = <&battery>;
      };
    };
```

## Documentation/devicetree/bindings/power/supply/qcom,pmi632-qg.yaml
```yaml
# SPDX-License-Identifier: (GPL-2.0-only OR BSD-2-Clause)
%YAML 1.2
---
$id: http://devicetree.org/schemas/power/supply/qcom,pmi632-qg.yaml#
$schema: http://devicetree.org/meta-schemas/core.yaml#

title: Qualcomm PMI632 QGauge Fuel Gauge

maintainers:
  - Marc Lainez <marc.lainez@gmail.com>

description:
  The QGauge (QG) block found in the Qualcomm PMI632 PMIC provides battery
  fuel gauging through hardware voltage and current FIFO sampling, open
  circuit voltage (OCV) measurement, and coulomb counting. The hardware
  has a multi-state FSM (S1-S7) that automatically transitions between
  active sampling and low-power sleep states.

allOf:
  - $ref: power-supply.yaml#

properties:
  compatible:
    const: qcom,pmi632-qg

  reg:
    maxItems: 1

  interrupts:
    items:
      - description: Battery missing interrupt
      - description: Battery voltage low interrupt
      - description: Battery voltage empty interrupt
      - description: FIFO data update done interrupt
      - description: Good OCV measured interrupt
      - description: FSM state change interrupt
      - description: QG event interrupt

  interrupt-names:
    items:
      - const: batt-missing
      - const: vbat-low
      - const: vbat-empty
      - const: fifo-done
      - const: good-ocv
      - const: fsm-state-chg
      - const: event

  io-channels:
    items:
      - description: ADC channel for battery thermistor temperature

  io-channel-names:
    items:
      - const: batt-therm

  monitored-battery: true

  power-supplies: true

required:
  - compatible
  - reg
  - interrupts
  - interrupt-names
  - monitored-battery

additionalProperties: false

examples:
  - |
    #include <dt-bindings/interrupt-controller/irq.h>
    pmic {
      #address-cells = <1>;
      #size-cells = <0>;

      fuel-gauge@4800 {
        compatible = "qcom,pmi632-qg";
        reg = <0x4800>;
        interrupts = <0x2 0x48 0x0 IRQ_TYPE_EDGE_BOTH>,
                     <0x2 0x48 0x1 IRQ_TYPE_EDGE_BOTH>,
                     <0x2 0x48 0x2 IRQ_TYPE_EDGE_RISING>,
                     <0x2 0x48 0x3 IRQ_TYPE_EDGE_RISING>,
                     <0x2 0x48 0x4 IRQ_TYPE_EDGE_RISING>,
                     <0x2 0x48 0x5 IRQ_TYPE_EDGE_RISING>,
                     <0x2 0x48 0x6 IRQ_TYPE_EDGE_RISING>;
        interrupt-names = "batt-missing",
                          "vbat-low",
                          "vbat-empty",
                          "fifo-done",
                          "good-ocv",
                          "fsm-state-chg",
                          "event";

        monitored-battery = <&battery>;
      };
    };
```

## Documentation/devicetree/bindings/sound/ti,tas2557.yaml
```yaml
# SPDX-License-Identifier: (GPL-2.0-only OR BSD-2-Clause)
# Copyright (C) 2026 Gianluca Boiano <morf3089@gmail.com>
%YAML 1.2
---
$id: http://devicetree.org/schemas/sound/ti,tas2557.yaml#
$schema: http://devicetree.org/meta-schemas/core.yaml#

title: Texas Instruments TAS2557 Mono Smart Amplifier

maintainers:
  - Gianluca Boiano <morf3089@gmail.com>

description: |
  The TAS2557 is a mono, digital-input Class-D amplifier with an
  integrated DSP for speaker protection. Audio is carried over I2S/TDM
  (ASI). The on-chip DSP boots from a firmware image that is generated
  for a specific speaker design using the TI PurePath Console tuning
  tools.

  A single node describes either one physical TAS2557, or up to two of
  them sharing one ASI bus and one reset/IRQ pair, using the same
  reg-array convention as
  Documentation/devicetree/bindings/sound/ti,tas2781.yaml. When two
  devices are listed, `reg` carries both I2C addresses and the
  physical device at each index is implicitly assigned one half of a
  stereo-tuned firmware image: the device at index 0 is DEV_A and the
  device at index 1 is DEV_B. No explicit channel-selection property
  exists or is needed -- the order of addresses in `reg` is the only
  configuration required. `ti,imon-slot-nos` and `ti,vmon-slot-nos`
  follow the same indexing: the item at array index N sets the TDM TX
  slot used by the device at the Nth `reg` entry.

  The uCDSP firmware format defines only the DEV_A and DEV_B device
  types, so `reg` (and the two TDM slot properties) cannot list more
  than two entries, regardless of how many physical speakers the board
  has.

  Datasheet: https://www.ti.com/lit/gpn/tas2557

allOf:
  - $ref: dai-common.yaml#

properties:
  compatible:
    const: ti,tas2557

  reg:
    minItems: 1
    maxItems: 2
    description:
      I2C address of each physical device sharing this node. One
      entry configures a single mono TAS2557. Two entries configure a
      device pair; the device at index 0 is DEV_A and the device at
      index 1 is DEV_B.

  '#sound-dai-cells':
    const: 0

  reset-gpios:
    maxItems: 1
    description: GPIO connected to the active-low RESET pin.

  interrupts:
    maxItems: 1
    description: Fault interrupt output (INT).

  vbat-supply:
    description: Battery/boost input supply (VBAT), 2.9 V to 5.5 V.

  iovdd-supply:
    description: Digital I/O supply, 1.62 V to 3.6 V.

  avdd-supply:
    description: Analog supply, 1.65 V to 1.95 V.

  dvdd-supply:
    description: Digital core supply, 1.65 V to 1.95 V.

  ti,imon-slot-nos:
    $ref: /schemas/types.yaml#/definitions/uint32-array
    minItems: 1
    maxItems: 2
    items:
      minimum: 0
      maximum: 7
    description:
      TDM TX time slot(s) for current-sense data, one entry per `reg`
      entry. The item at array index N configures the device at the
      Nth `reg` entry.

  ti,vmon-slot-nos:
    $ref: /schemas/types.yaml#/definitions/uint32-array
    minItems: 1
    maxItems: 2
    items:
      minimum: 0
      maximum: 7
    description:
      TDM TX time slot(s) for voltage-sense data, one entry per `reg`
      entry. The item at array index N configures the device at the
      Nth `reg` entry.

  firmware-name:
    maxItems: 1
    description: |
      Name of the DSP firmware image to load. Defaults to a name
      derived from the silicon revision. A device pair shares one
      image; each device's half of it is selected by its `reg` index,
      not by this property.

required:
  - compatible
  - reg
  - '#sound-dai-cells'
  - vbat-supply
  - iovdd-supply
  - avdd-supply
  - dvdd-supply

unevaluatedProperties: false

examples:
  - |
    #include <dt-bindings/gpio/gpio.h>
    #include <dt-bindings/interrupt-controller/irq.h>

    i2c {
        #address-cells = <1>;
        #size-cells = <0>;

        audio-codec@4c {
            compatible = "ti,tas2557";
            reg = <0x4c>;
            #sound-dai-cells = <0>;
            reset-gpios = <&tlmm 77 GPIO_ACTIVE_LOW>;
            interrupt-parent = <&tlmm>;
            interrupts = <73 IRQ_TYPE_LEVEL_HIGH>;

            vbat-supply = <&vph_pwr>;
            iovdd-supply = <&vreg_l6b_1p8>;
            avdd-supply = <&vreg_l6b_1p8>;
            dvdd-supply = <&vreg_l6b_1p8>;

            ti,imon-slot-nos = <0>;
            ti,vmon-slot-nos = <2>;
        };
    };
  - |
    #include <dt-bindings/gpio/gpio.h>
    #include <dt-bindings/interrupt-controller/irq.h>

    i2c {
        #address-cells = <1>;
        #size-cells = <0>;

        audio-codec@4c {
            compatible = "ti,tas2557";
            reg = <0x4c>, <0x4d>;
            #sound-dai-cells = <0>;
            reset-gpios = <&tlmm 77 GPIO_ACTIVE_LOW>;
            interrupt-parent = <&tlmm>;
            interrupts = <73 IRQ_TYPE_LEVEL_HIGH>;

            vbat-supply = <&vph_pwr>;
            iovdd-supply = <&vreg_l6b_1p8>;
            avdd-supply = <&vreg_l6b_1p8>;
            dvdd-supply = <&vreg_l6b_1p8>;

            ti,imon-slot-nos = <0 1>;
            ti,vmon-slot-nos = <2 3>;
            firmware-name = "tas2557-stereo.bin";
        };
    };
...
```
